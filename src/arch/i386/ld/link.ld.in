OUTPUT_FORMAT("elf32-i386")
ENTRY("_start")
STARTUP(@@STARTUP@@);

SECTIONS
{
    . = 0xC0100000;

    kernel_start = ALIGN(0x1000);

    .text   ALIGN(0x1000) : AT(ADDR(.text)   - 0xC0000000) { *(.text)   }
    .rodata ALIGN(0x1000) : AT(ADDR(.rodata) - 0xC0000000) { *(.rodata) }
    .data   ALIGN(0x1000) : AT(ADDR(.data)   - 0xC0000000) { *(.data)   }
    .bss    ALIGN(0x1000) : AT(ADDR(.bss)    - 0xC0000000) { *(.bss)    }

    /DISCARD/ : { *(*) }

    kernel_end = ALIGN(0x1000);
}
