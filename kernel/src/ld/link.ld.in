OUTPUT_FORMAT("elf32-i386")
ENTRY("_start")
STARTUP(@@STARTUP@@);
INHIBIT_COMMON_ALLOCATION;

SECTIONS {
    . = 0xC0000000;
    kernel_origin = .;

    /* The kernel starts at the first MiB of the fourth GiB. */
    . += 1M;
    kernel_start = .;

    /* The read-only section of the kernel. */
    kernel_ro_start = .;
    .text     ALIGN(4K) : AT(ADDR(.text)     - kernel_origin) { *(.text)           }
    .rodata   ALIGN(4K) : AT(ADDR(.rodata)   - kernel_origin) { *(.rodata*)        }
    .eh_frame ALIGN(4K) : AT(ADDR(.eh_frame) - kernel_origin) { KEEP(*(.eh_frame)) }
    kernel_ro_end = .;

    /* The read-write section of the kernel. */
    kernel_rw_start = .;
    .data     ALIGN(4K) : AT(ADDR(.data)     - kernel_origin) { *(.data)           }
    .bss      ALIGN(4K) : AT(ADDR(.bss)      - kernel_origin) { *(.bss)            }
    kernel_rw_end = .;

    /* The kernel ends here. */
    kernel_end = .;

    /* The kernel's heap is 256 MiB. */
    . = 0xE0000000;
    kernel_heap_start = .;
    . += 256M;
    kernel_heap_end = .;
}
